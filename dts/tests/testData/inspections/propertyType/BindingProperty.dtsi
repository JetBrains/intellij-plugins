/ {
    node {
        compatible = "espressif,esp32-eth";

        local-mac-address = [12 34];
        local-mac-address = <error descr="Expected property of type: uint8-array">"string"</error>;
    };
};