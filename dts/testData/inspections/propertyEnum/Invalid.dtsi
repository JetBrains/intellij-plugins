/ {
    node {
        compatible = "custom,enum";

        prop-int = <error descr="Expected property value from enum: <10>, <11>"><12></error>;
        <error descr="Expected property value from enum: \"value1\", \"value2\"">prop-string</error>;
    };
};
