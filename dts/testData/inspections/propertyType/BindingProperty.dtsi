/ {
    node {
        compatible = "espressif,esp32-eth";

        local-mac-address = [12 34];
        <error descr="Expected property of type: uint8-array">local-mac-address</error> = "string";
    };
};